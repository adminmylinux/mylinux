## Config.in
```kconfig
source "$BR2_EXTERNAL_MYLINUX_PATH/package/myapp/Config.in"
source "$BR2_EXTERNAL_MYLINUX_PATH/package/myshell/Config.in"
source "$BR2_EXTERNAL_MYLINUX_PATH/package/inter/Config.in"
```

## package/inter/Config.in
```kconfig
config BR2_PACKAGE_INTER
	bool "inter font"
	help
	  Inter, the open-source UI typeface by Rasmus Andersson (SIL OFL 1.1).
	  https://rsms.me/inter/
```

## package/libvterm/Config.in
```kconfig
config BR2_PACKAGE_LIBVTERM
	bool "libvterm"
	help
	  An abstract VT220/xterm/ECMA-48 terminal emulator library (the one behind neovim's :terminal).
	  vncview draws its SSH tabs with it.

	  https://www.leonerd.org.uk/code/libvterm/
```

## package/myapp/Config.in
```kconfig
config BR2_PACKAGE_MYAPP
	bool "myapp"
	depends on BR2_PACKAGE_QT6
	select BR2_PACKAGE_QT6BASE
	select BR2_PACKAGE_QT6BASE_GUI
	select BR2_PACKAGE_QT6DECLARATIVE
	select BR2_PACKAGE_QT6DECLARATIVE_QUICK
	help
	  The mylinux Qt 6 / QML GUI application (source in app/).
```

## package/myshell/Config.in
```kconfig
config BR2_PACKAGE_MYSHELL
	bool "myshell"
	depends on BR2_PACKAGE_QT6
	select BR2_PACKAGE_QT6BASE
	select BR2_PACKAGE_QT6BASE_GUI
	select BR2_PACKAGE_QT6DECLARATIVE
	select BR2_PACKAGE_QT6DECLARATIVE_QUICK
	select BR2_PACKAGE_QT6WAYLAND
	select BR2_PACKAGE_QT6WAYLAND_COMPOSITOR
	help
	  The mylinux desktop shell: a Qt Wayland compositor in QML (source in shell/).
```
